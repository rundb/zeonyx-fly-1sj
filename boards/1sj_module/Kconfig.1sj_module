## boards/1sj_module/Kconfig.1sj_module
```kconfig
# Copyright (c) 2024
# SPDX-License-Identifier: Apache-2.0

config BOARD_1SJ_MODULE
	select SOC_STM32L072XX
```

## boards/1sj_module/board.yml
```yaml
board:
  name: 1sj_module
  full_name: 1SJ LoRa Module (STM32L072CZ + SX1262)
  vendor: custom
  socs:
    - name: stm32l072xx
```
